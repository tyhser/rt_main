## applications/Kconfig
```kconfig
menu "Application Config"

menu "Communications Port Config"

    config APP_RS485_MOTOR_DRIVER
	bool "rs485 port for motor driver"
	default y

endmenu

menu "Replaceable physical module"

    config APP_USING_PISTON_PUMP
	bool "syring using piston pump"
	default n
    config APP_USING_PMC_SAMPLER
	bool "syring using pmc005 control sampler"
	default n

endmenu

endmenu
```

## board/Kconfig
```kconfig
menu "Hardware Drivers Config"

config SOC_STM32F407ZG
    bool
    select SOC_SERIES_STM32F4
    select RT_USING_COMPONENTS_INIT
    select RT_USING_USER_MAIN
    default y

menu "Onboard Peripheral Drivers"
    menuconfig BSP_USING_EXTERNED_ADC
        bool "Enable Extern ADC"
        default y
        if BSP_USING_EXTERNED_ADC
            config BSP_USING_CS1237
                bool "Enable CS1237"
                default y
        endif
endmenu

menu "On-chip Peripheral Drivers"

    config BSP_USING_GPIO
        bool "Enable GPIO"
        select RT_USING_PIN
        default y

    menuconfig BSP_USING_UART
        bool "Enable UART"
        default y
        select RT_USING_SERIAL
        if BSP_USING_UART
            config BSP_USING_UART1
                bool "Enable UART1"
                default y

            config BSP_UART1_RX_USING_DMA
                bool "Enable UART1 RX DMA"
                depends on BSP_USING_UART1 && RT_SERIAL_USING_DMA
                default n

            config BSP_USING_UART3
                bool "Enable UART3"
                default y

            config BSP_UART3_RX_USING_DMA
                bool "Enable UART3 RX DMA"
                depends on BSP_USING_UART3 && RT_SERIAL_USING_DMA
                default n

            config BSP_USING_UART6
                bool "Enable UART6"
                default y

            config BSP_UART6_RX_USING_DMA
                bool "Enable UART6 RX DMA"
                depends on BSP_USING_UART6 && RT_SERIAL_USING_DMA
                default n
        endif
        
    source "libraries/HAL_Drivers/Kconfig"
    
endmenu

menu "Board extended module Drivers"

endmenu
 
endmenu
```
